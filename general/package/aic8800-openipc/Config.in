## general/package/aic8800-openipc/Config.in
```kconfig
config BR2_PACKAGE_AIC8800_OPENIPC
	bool "OpenIPC AIC8800 USB Wi-Fi driver"
	depends on BR2_LINUX_KERNEL
	help
	  USB driver for AIC8800 devices, including the D80 combo module.
	  Firmware blobs are supplied separately by the local board integration.
```

## lumi/Config.in
```kconfig
menu "Lumi packages"
source "$BR2_EXTERNAL_LUMI_PATH/package/lumi-aic8800/Config.in"
source "$BR2_EXTERNAL_LUMI_PATH/package/lumi-osdrv-t33/Config.in"
source "$BR2_EXTERNAL_LUMI_PATH/package/lumi-t23-dual-sdk/Config.in"
endmenu
```

## lumi/configs/lumi_t23n_dual_nor16_defconfig
```kconfig
# T23N dual OS02N10 / AIC8800DC USB, MX25L12835F 16 MiB.
BR2_mipsel=y
BR2_mips_xburst=y
# BR2_MIPS_SOFT_FLOAT is not set
BR2_MIPS_FP32_MODE_32=y
BR2_TOOLCHAIN_EXTERNAL=y
BR2_TOOLCHAIN_EXTERNAL_CUSTOM=y
BR2_TOOLCHAIN_EXTERNAL_DOWNLOAD=y
BR2_TOOLCHAIN_EXTERNAL_URL="https://github.com/openipc/firmware/releases/download/toolchain/toolchain.ingenic-t31.tgz"
BR2_TOOLCHAIN_EXTERNAL_CUSTOM_PREFIX="mipsel-openipc-linux-musl"
BR2_TOOLCHAIN_EXTERNAL_HEADERS_3_10=y
BR2_TOOLCHAIN_EXTERNAL_CUSTOM_MUSL=y
BR2_TOOLCHAIN_EXTERNAL_CXX=y
BR2_LINUX_KERNEL=y
BR2_LINUX_KERNEL_CUSTOM_TARBALL=y
BR2_LINUX_KERNEL_CUSTOM_TARBALL_LOCATION="https://github.com/openipc/linux/archive/ingenic-t23.tar.gz"
BR2_LINUX_KERNEL_USE_CUSTOM_CONFIG=y
BR2_LINUX_KERNEL_CUSTOM_CONFIG_FILE="$(EXTERNAL_VENDOR)/board/t23/t23.generic.config"
BR2_LINUX_KERNEL_CONFIG_FRAGMENT_FILES="$(BR2_EXTERNAL_LUMI_PATH)/board/t23n-dual/board.fragment"
BR2_LINUX_KERNEL_LZMA=y
BR2_PACKAGE_BUSYBOX_CONFIG="$(BR2_EXTERNAL_GENERAL_PATH)/package/busybox/busybox.config"
# BR2_PACKAGE_IFUPDOWN_SCRIPTS is not set
BR2_PACKAGE_UBOOT_TOOLS=y
BR2_PACKAGE_DROPBEAR_OPENIPC=y
BR2_PACKAGE_IPCTOOL=y
BR2_PACKAGE_I2C_TOOLS=y
BR2_PACKAGE_IW=y
BR2_PACKAGE_WIRELESS_TOOLS=y
BR2_PACKAGE_WPA_SUPPLICANT=y
BR2_PACKAGE_WPA_SUPPLICANT_CLI=y
BR2_PACKAGE_WPA_SUPPLICANT_PASSPHRASE=y
BR2_PACKAGE_LUMI_T23_DUAL_SDK=y
BR2_PACKAGE_LUMI_AIC8800=y
# BR2_PACKAGE_INGENIC_OSDRV_T23 is not set
# BR2_PACKAGE_INGENIC_OPENSDK is not set
# BR2_PACKAGE_MAJESTIC is not set
# BR2_PACKAGE_MAJESTIC_WEBUI is not set
# BR2_PACKAGE_MAJESTIC_FONTS is not set
BR2_TARGET_ROOTFS_CPIO=y
BR2_TARGET_ROOTFS_SQUASHFS=y
BR2_TARGET_ROOTFS_SQUASHFS4_XZ=y
BR2_ROOTFS_OVERLAY="$(BR2_EXTERNAL_GENERAL_PATH)/overlay $(BR2_EXTERNAL_LUMI_PATH)/overlay $(BR2_EXTERNAL_LUMI_PATH)/board/t23n-dual/overlay"
BR2_ROOTFS_POST_BUILD_SCRIPT="$(BR2_EXTERNAL_GENERAL_PATH)/scripts/rootfs_script.sh $(BR2_EXTERNAL_LUMI_PATH)/scripts/post-build.sh"
BR2_OPENIPC_SOC_VENDOR="ingenic"
BR2_OPENIPC_SOC_MODEL="t23"
BR2_OPENIPC_SOC_FAMILY="t23"
BR2_OPENIPC_VARIANT="lumi-dual"
BR2_OPENIPC_FLASH_SIZE="16"
```

## lumi/configs/lumi_t33_template_gc4653_defconfig
```kconfig
# Architecture
BR2_mipsel=y
BR2_mips_xburst=y
# BR2_MIPS_SOFT_FLOAT is not set
BR2_MIPS_FP32_MODE_32=y

# Toolchain
BR2_TOOLCHAIN_EXTERNAL=y
BR2_TOOLCHAIN_EXTERNAL_CUSTOM=y
BR2_TOOLCHAIN_EXTERNAL_DOWNLOAD=y
BR2_TOOLCHAIN_EXTERNAL_URL="https://github.com/openipc/firmware/releases/download/toolchain/toolchain.ingenic-t31.tgz"
BR2_TOOLCHAIN_EXTERNAL_CUSTOM_PREFIX="mipsel-openipc-linux-musl"
BR2_TOOLCHAIN_EXTERNAL_HEADERS_3_10=y
BR2_TOOLCHAIN_EXTERNAL_CUSTOM_MUSL=y
BR2_TOOLCHAIN_EXTERNAL_CXX=y

# Kernel
BR2_LINUX_KERNEL=y
BR2_LINUX_KERNEL_CUSTOM_VERSION=y
BR2_LINUX_KERNEL_CUSTOM_VERSION_VALUE="3.10.14"
BR2_LINUX_KERNEL_USE_DEFCONFIG=y
BR2_LINUX_KERNEL_DEFCONFIG="PRJ008_goat"
BR2_LINUX_KERNEL_CONFIG_FRAGMENT_FILES="$(BR2_EXTERNAL_LUMI_PATH)/board/t33gs-prj008/t33.fragment"
BR2_LINUX_KERNEL_PATCH="$(BR2_EXTERNAL_LUMI_PATH)/board/t33gs-prj008/patches/linux"
BR2_LINUX_KERNEL_UIMAGE=y
BR2_LINUX_KERNEL_LZMA=y

# Filesystem
BR2_PACKAGE_BUSYBOX_CONFIG="$(BR2_EXTERNAL_GENERAL_PATH)/package/busybox/busybox.config"
BR2_ROOTFS_OVERLAY="$(BR2_EXTERNAL_GENERAL_PATH)/overlay $(BR2_EXTERNAL_LUMI_PATH)/overlay $(BR2_EXTERNAL_LUMI_PATH)/board/t33gs-prj008/overlay"
BR2_ROOTFS_POST_BUILD_SCRIPT="$(BR2_EXTERNAL_GENERAL_PATH)/scripts/rootfs_script.sh $(BR2_EXTERNAL_LUMI_PATH)/scripts/post-build.sh"
BR2_ROOTFS_POST_IMAGE_SCRIPT="$(BR2_EXTERNAL_LUMI_PATH)/scripts/post-image-t33.sh"
BR2_PACKAGE_HOST_UBOOT_TOOLS=y
BR2_PACKAGE_UBOOT_TOOLS=y
# BR2_PACKAGE_IFUPDOWN_SCRIPTS is not set
BR2_TARGET_ROOTFS_CPIO=y
BR2_TARGET_ROOTFS_SQUASHFS=y
BR2_TARGET_ROOTFS_SQUASHFS4_XZ=y

# OpenIPC SoC & Sensor
BR2_OPENIPC_SOC_VENDOR="ingenic"
BR2_OPENIPC_SOC_MODEL="t33"
BR2_OPENIPC_SOC_FAMILY="t33"
BR2_OPENIPC_SNS_MODEL="gc4653"
BR2_OPENIPC_VARIANT="lite"
BR2_OPENIPC_FLASH_SIZE="16"

# Lumi T33 Hardware Package & Pinmux (Sample: GC4653 4MP sensor)
BR2_PACKAGE_LUMI_OSDRV_T33=y
BR2_LUMI_T33_SOC_PROJECT="PRJ008"
BR2_LUMI_T33_SNS_MODEL="gc4653"
BR2_LUMI_T33_WIFI_PWR_GPIO="72"
BR2_LUMI_T33_IRCUT_PIN_A="66"
BR2_LUMI_T33_IRCUT_PIN_B="67"

# Userspace and Wi-Fi connection tools
BR2_PACKAGE_DROPBEAR_OPENIPC=y
BR2_PACKAGE_IPCTOOL=y
BR2_PACKAGE_AIC8800_OPENIPC=y
BR2_PACKAGE_IW=y
BR2_PACKAGE_WIRELESS_TOOLS=y
BR2_PACKAGE_WPA_SUPPLICANT=y
BR2_PACKAGE_WPA_SUPPLICANT_CLI=y
BR2_PACKAGE_WPA_SUPPLICANT_PASSPHRASE=y
```

## lumi/configs/lumi_t33gs_prj008_nor16_defconfig
```kconfig
# Architecture
BR2_mipsel=y
BR2_mips_xburst=y
# BR2_MIPS_SOFT_FLOAT is not set
BR2_MIPS_FP32_MODE_32=y

# Toolchain
BR2_TOOLCHAIN_EXTERNAL=y
BR2_TOOLCHAIN_EXTERNAL_CUSTOM=y
BR2_TOOLCHAIN_EXTERNAL_DOWNLOAD=y
BR2_TOOLCHAIN_EXTERNAL_URL="https://github.com/openipc/firmware/releases/download/toolchain/toolchain.ingenic-t31.tgz"
BR2_TOOLCHAIN_EXTERNAL_CUSTOM_PREFIX="mipsel-openipc-linux-musl"
BR2_TOOLCHAIN_EXTERNAL_HEADERS_3_10=y
BR2_TOOLCHAIN_EXTERNAL_CUSTOM_MUSL=y
BR2_TOOLCHAIN_EXTERNAL_CXX=y

# Kernel source is supplied from the local Ingenic T32/T33 SDK by
# contrib/build-t33.sh (see lumi/board/t33gs-prj008/README.md). The SDK's PRJ008 GOAT defconfig matches this board.
BR2_LINUX_KERNEL=y
BR2_LINUX_KERNEL_CUSTOM_VERSION=y
BR2_LINUX_KERNEL_CUSTOM_VERSION_VALUE="3.10.14"
BR2_LINUX_KERNEL_USE_DEFCONFIG=y
BR2_LINUX_KERNEL_DEFCONFIG="PRJ008_goat"
BR2_LINUX_KERNEL_CONFIG_FRAGMENT_FILES="$(BR2_EXTERNAL_LUMI_PATH)/board/t33gs-prj008/t33.fragment"
BR2_LINUX_KERNEL_UIMAGE=y
BR2_LINUX_KERNEL_LZMA=y

# Filesystem
BR2_PACKAGE_BUSYBOX_CONFIG="$(BR2_EXTERNAL_GENERAL_PATH)/package/busybox/busybox.config"
BR2_ROOTFS_OVERLAY="$(BR2_EXTERNAL_GENERAL_PATH)/overlay $(BR2_EXTERNAL_LUMI_PATH)/overlay $(BR2_EXTERNAL_LUMI_PATH)/board/t33gs-prj008/overlay"
BR2_ROOTFS_POST_BUILD_SCRIPT="$(BR2_EXTERNAL_LUMI_PATH)/board/t33gs-prj008/post-build.sh $(BR2_EXTERNAL_GENERAL_PATH)/scripts/rootfs_script.sh $(BR2_EXTERNAL_LUMI_PATH)/scripts/post-build.sh"
BR2_PACKAGE_HOST_UBOOT_TOOLS=y
BR2_PACKAGE_UBOOT_TOOLS=y
# BR2_PACKAGE_IFUPDOWN_SCRIPTS is not set
BR2_TARGET_ROOTFS_CPIO=y
BR2_TARGET_ROOTFS_SQUASHFS=y
BR2_TARGET_ROOTFS_SQUASHFS4_XZ=y

# OpenIPC
BR2_OPENIPC_SOC_VENDOR="ingenic"
BR2_OPENIPC_SOC_MODEL="t33"
BR2_OPENIPC_SOC_FAMILY="t33"
BR2_OPENIPC_VARIANT="lite"
BR2_OPENIPC_FLASH_SIZE="16"

# OpenIPC userspace and Wi-Fi connection tools for the T33 AIC8800D80 module.
BR2_PACKAGE_DROPBEAR_OPENIPC=y
BR2_PACKAGE_IPCTOOL=y
BR2_PACKAGE_AIC8800_OPENIPC=y
BR2_PACKAGE_IW=y
BR2_PACKAGE_WIRELESS_TOOLS=y
BR2_PACKAGE_WPA_SUPPLICANT=y
BR2_PACKAGE_WPA_SUPPLICANT_CLI=y
BR2_PACKAGE_WPA_SUPPLICANT_PASSPHRASE=y
```

## lumi/package/lumi-aic8800/Config.in
```kconfig
config BR2_PACKAGE_LUMI_AIC8800
	bool "Lumi AIC8800DC USB Wi-Fi"
	depends on BR2_LINUX_KERNEL
	depends on !BR2_PACKAGE_AIC8800_OPENIPC
	help
	  USB a69c:88dc driver and complete AIC8800DC firmware payload.
	  Documented upstream: https://github.com/gtxaspec/aic8800-wifi
```

## lumi/package/lumi-osdrv-t33/Config.in
```kconfig
config BR2_PACKAGE_LUMI_OSDRV_T33
	bool "Lumi Ingenic T33 OSDRV (ISP, Sensor, Audio, libimp)"
	depends on BR2_LINUX_KERNEL
	default y if BR2_OPENIPC_SOC_MODEL = "t33"
	help
	  Ingenic T32/T33 camera driver stack and media runtime.
	  Includes TX-ISP kernel module, image sensor driver,
	  OSS3 audio driver, and isolated uClibc libimp runtime.

if BR2_PACKAGE_LUMI_OSDRV_T33

config BR2_LUMI_T33_SOC_PROJECT
	string "Ingenic SoC Project Identifier"
	default "PRJ008"
	help
	  Ingenic T33 chip configuration project ID (e.g. PRJ008 for T33gs).

config BR2_LUMI_T33_SNS_MODEL
	string "Image sensor model"
	default "sc4336"
	help
	  Sensor model name (e.g. sc4336, gc4653, sc2336).

config BR2_LUMI_T33_WIFI_PWR_GPIO
	string "Wi-Fi Power / Reset GPIO pin"
	default "72"
	help
	  GPIO pin used to cycle power or reset the Wi-Fi module.

config BR2_LUMI_T33_IRCUT_PIN_A
	string "IR-Cut Pin A (BIN) GPIO"
	default "66"
	help
	  Linux GPIO offset for IR-Cut filter direction line A.

config BR2_LUMI_T33_IRCUT_PIN_B
	string "IR-Cut Pin B (AIN) GPIO"
	default "67"
	help
	  Linux GPIO offset for IR-Cut filter direction line B.

endif
```

## lumi/package/lumi-t23-dual-sdk/Config.in
```kconfig
config BR2_PACKAGE_LUMI_T23_DUAL_SDK
	bool "Lumi T23 dual OS02N10 SDK"
	depends on BR2_LINUX_KERNEL && BR2_mipsel
	depends on !BR2_PACKAGE_INGENIC_OPENSDK
	help
	  Matching ISP 1.3.0-double, OS02N10 s0/s1 and audio modules.
	  Driver source and vendor ISP archive: https://github.com/thingino/ingenic-sdk
```
